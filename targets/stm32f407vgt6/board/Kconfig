## targets/stm32f407vgt6/board/Kconfig
```kconfig
menu "Hardware Drivers Config"

config SOC_STM32F407VG
    bool
    select SOC_SERIES_STM32F4
    select RT_USING_COMPONENTS_INIT
    select RT_USING_USER_MAIN
    default y

menu "Onboard Peripheral Drivers"

    config BSP_USING_SPI_FLASH
        bool "Enable SPI FLASH (spi1)"
        select BSP_USING_SPI
        select BSP_USING_SPI1
        select RT_USING_FAL
        select FAL_USING_SFUD_PORT
        select RT_USING_SFUD
        default n

    config BSP_USING_QSPI_FLASH
        bool "Enable QSPI FLASH (w25q128 qspi)"
        select BSP_USING_QSPI
        select FAL_USING_SFUD_PORT
        select RT_USING_SFUD
        select RT_SFUD_USING_QSPI
        default n

    menuconfig BSP_USING_FS
        bool "Enable filesystem"
        select RT_USING_DFS
        select RT_USING_DFS_ROMFS
        default n
        if BSP_USING_FS
            config BSP_USING_SDCARD_FS
                bool "Enable SDCARD filesystem"
                select BSP_USING_SDIO_ARTPI
                select BSP_USING_SDIO
                select BSP_USING_SDIO1
                select RT_USING_DFS_ELMFAT
                default n
            config BSP_USING_SPI_FLASH_FS
                bool "Enable SPI FLASH filesystem"
                select BSP_USING_SPI_FLASH
                select RT_USING_MTD_NOR
                select PKG_USING_LITTLEFS
                default n
        endif

endmenu

menu "On-chip Peripheral Drivers"

    config BSP_USING_GPIO
        bool "Enable GPIO"
        select RT_USING_PIN
        default y

    menuconfig BSP_USING_UART
        bool "Enable UART"
        default y
        select RT_USING_SERIAL
        if BSP_USING_UART
            config BSP_USING_UART1
                bool "Enable UART1"
                default y

            config BSP_UART1_RX_USING_DMA
                bool "Enable UART1 RX DMA"
                depends on BSP_USING_UART1 && RT_SERIAL_USING_DMA
                default n
            
            config BSP_UART1_TX_USING_DMA
                bool "Enable UART1 TX DMA"
                depends on BSP_USING_UART1 && RT_SERIAL_USING_DMA
                default n

            config BSP_USING_UART6
                bool "Enable UART6"
                default y

            config BSP_UART6_RX_USING_DMA
                bool "Enable UART6 RX DMA"
                depends on BSP_USING_UART6 && RT_SERIAL_USING_DMA
                default n
            
            config BSP_UART6_TX_USING_DMA
                bool "Enable UART6 TX DMA"
                depends on BSP_USING_UART6 && RT_SERIAL_USING_DMA
                default n

            config RT_CONSOLE_DEVICE_NAME
                string "the device name for console"
                default "uart0"
        endif

    menuconfig BSP_USING_SPI
        bool "Enable SPI BUS"
        default n
        select RT_USING_SPI
        if BSP_USING_SPI
            config BSP_USING_SPI1
                bool "Enable SPI1 BUS"
                default n

            config BSP_SPI1_TX_USING_DMA
                bool "Enable SPI1 TX DMA"
                depends on BSP_USING_SPI1
                default n

            config BSP_SPI1_RX_USING_DMA
                bool "Enable SPI1 RX DMA"
                depends on BSP_USING_SPI1
                select BSP_SPI1_TX_USING_DMA
                default n
        endif

    config BSP_USING_QSPI
        bool "Enable QSPI BUS"
        select RT_USING_QSPI
        select RT_USING_SPI
        default n

    config BSP_USING_ONCHIP_RTC
        bool "Enable Onchip RTC"
        select RT_USING_RTC
        default n

    config BSP_USING_WDT
        bool "Enable Watchdog Timer"
        select RT_USING_WDT
        default n

    menuconfig BSP_USING_SDIO_ARTPI
        bool "Enable SDIO"
        default n
        select RT_USING_SDIO
        if BSP_USING_SDIO_ARTPI
            config BSP_USING_SDIO1
                bool "Enable SDIO1"
                default n
            config BSP_USING_SDIO2
                bool "Enable SDIO2"
                default n
        endif

    config BSP_USING_USBD
        bool "Enable USB Device"
        select RT_USING_USB_DEVICE
        default n

    menuconfig BSP_USING_USBH
        bool "Enable USB Host"
        select RT_USING_USB_HOST
        default n
        if BSP_USING_USBH
            menuconfig RT_USBH_MSTORAGE
                bool "Enable Udisk Drivers"
                select RT_USING_DFS
                select RT_USING_DFS_ELMFAT
                default n
                if RT_USBH_MSTORAGE
                    config UDISK_MOUNTPOINT
                        string "Udisk mount dir"
                        default "/"
                endif
        endif

    menuconfig BSP_USING_I2C1
        bool "Enable I2C1 BUS (software simulation)"
        default n
        select RT_USING_I2C
        select RT_USING_I2C_BITOPS
        select RT_USING_PIN
        if BSP_USING_I2C1
            config BSP_I2C1_SCL_PIN
                int "i2c1 scl pin number"
                range 1 216
                default 24
            config BSP_I2C1_SDA_PIN
                int "I2C1 sda pin number"
                range 1 216
                default 25
        endif
    source "$RTT_DIR/bsp/stm32/libraries/HAL_Drivers/Kconfig"

endmenu

menu "Board extended module Drivers"

endmenu

endmenu
```
